## Kconfig
```kconfig
#!/bin/bash
function config_h
{
    cat .config | awk -F= '{if($2 ~ /^[0-9]+$|^0x[0-9a-fA-F]+$/) \
        print "#define "$1" "$2; else print "#define "$1" \""$2"\""}' > config.h
}

function config_S
{
    cat .config | awk -F= '{if($2 ~ /^[0-9]+$|^0x[0-9a-fA-F]+$/) \
        print $1" equ "$2; else print $1" equ \""$2"\""}' > config.S
}

echo "Configure NeuxOS Kernel..."

echo CONFIG_HD_SZ=${HD_SZ:-128M} >> .config
echo CONFIG_HD_SECT_SZ=${HD_SECT_SZ:-512} >> .config
echo CONFIG_HD_HEADS=${HD_HEADS:-16} >> .config
echo CONFIG_HD_SPT=${HD_SPT:-63} >> .config
echo CONFIG_SHARE_DATA_ADDR=${SHARE_DATA_ADDR:-0x60000} >> .config
echo CONFIG_EXT2_BS=${EXT2_BS:-1024} >> .config
echo CONFIG_KERNEL_VM_OFFSET=${KERNEL_VM_OFFSET:-0xc0000000} >> .config
echo CONFIG_KERNEL_PG_ADDR=${KERNEL_PG_ADDR:-0x100000} >> .config
echo CONFIG_KERNEL_RES_PAGES=${KERNEL_RES_PAGES:-1} >> .config
. .config

config_h
gcc config.c -o config && ./config >> .config
cat .config

config_h
echo "checking..."
gcc check.c -o check && ./check || exit 1
echo "SUCCESS"
config_S
```
